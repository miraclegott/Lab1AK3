/* Лінкерний скрипт для мікроконтролерів STM32F1 
 * Визначає розташування пам'яті, зокрема флеш (ROM) та оперативної пам’яті (RAM).
 */

MEMORY
{
    /* Описуємо флеш-пам’ять (ROM), де зберігається прошивка.
     * У STM32 флеш починається з адреси 0x08000000.
     * Розмір флеш-пам’яті: 1 МБ (можна змінити відповідно до моделі МК).
     */
    FLASH (rx) : ORIGIN = 0x08000000, LENGTH = 1M

    /* Описуємо оперативну пам’ять (RAM), яка використовується для змінних та стека.
     * Початкова адреса RAM: 0x20000000.
     * Розмір: 128 КБ (змінюйте відповідно до характеристик мікроконтролера).
     */
    RAM (rwx) : ORIGIN = 0x20000000, LENGTH = 128K
}

/* Визначаємо початок стека як вершину доступної RAM.
 * Це використовується стартовим кодом для ініціалізації стеку.
 */
__stack_start = ORIGIN(RAM) + LENGTH(RAM);
